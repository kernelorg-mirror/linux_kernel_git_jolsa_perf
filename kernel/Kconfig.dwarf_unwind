## kernel/Kconfig.dwarf_unwind
```kconfig
config DWARF_UNWIND
	bool "Use compiler information to unwind the stack."
	---help---
	  Adding code allowing to use compiled debug data
	  for stack unwinding.

config DWARF_UNWIND_DEBUG
	bool "Get debug output in console."
	depends on DWARF_UNWIND

config DWARF_UNWIND_EH_FRAMES
	def_bool DWARF_UNWIND
```

## kernel/unwind/Kconfig
```kconfig
config UNWIND
	bool "Use compiler information to unwind the stack."
	---help---
	  Adding code allowing to use compiled debug data
	  for stack unwinding.

config UNWIND_EH_FRAMES
	def_bool UNWIND
```

## tools/perf/Kconfig
```kconfig
mainmenu "Perf Configuration"

menu "Builtin commands"

config BUILTIN_TEST
	bool "Tests"

endmenu # "Builtin commands"
```
